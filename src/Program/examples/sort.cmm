function bubbleSort(arr) {
    n = len(arr);
    for (i = 0; i < n - 1; i = i + 1) {
        for (j = 0; j < n - i - 1; j = j + 1) {
            if (arr[j] > arr[j + 1]) {
                temp = arr[j];
                arr[j] = arr[j + 1];
                arr[j + 1] = temp;
            }
        }
    }
    return arr;
}

function main() {
    array a[10];

    for (i = len(a); i > 0; i = i - 1) {
        a[len(a) - i] = i;
    }

    print a;
    print bubbleSort(a);
}
